/**
 *
 * @cliArgs --board "/boards/LAUNCHXL_F280049C" --device "F28004x" --part "F28004x_100PZ" --package "F28004x_100PZ" --context "system" --product "C2000WARE@26.01.00.00"
 * @versions {"tool":"1.28.0+4696"}
 */

/**
 * Import the modules used in this configuration.
 */
const led       = scripting.addModule("/driverlib/board_components/led", {}, false);
const led1      = led.addInstance();
const led2      = led.addInstance();
const FREERTOS  = scripting.addModule("/kernel/freertos_tool/FREERTOS", {}, false);
const FREERTOS1 = FREERTOS.addInstance();

/**
 * Write custom configuration values to the imported modules.
 */
led1.$name     = "myBoardLED0";
led1.$hardware = system.deviceData.board.components.LED4;

led2.$name     = "myBoardLED1";
led2.$hardware = system.deviceData.board.components.LED5;

FREERTOS1.$name                 = "myFREERTOS0";
FREERTOS1.tasks.create(2);
FREERTOS1.tasks[0].$name        = "LED_RedTask";
FREERTOS1.tasks[0].taskPointer  = "LED_RedTask";
FREERTOS1.tasks[1].taskPriority = 1;
FREERTOS1.tasks[1].$name        = "LED_GreenTask";
FREERTOS1.tasks[1].taskPointer  = "LED_GreenTask";

/**
 * Pinmux solution for unlocked pins/peripherals. This ensures that minor changes to the automatic solver in a future
 * version of the tool will not impact the pinmux you originally saw.  These lines can be completely deleted in order to
 * re-solve from scratch.
 */
led1.gpio.gpioPin.$suggestSolution = "boosterpack1.12";
led2.gpio.gpioPin.$suggestSolution = "boosterpack2.52";
