/**
 *
 * @cliArgs --board "/boards/LAUNCHXL_F280049C" --device "F28004x" --part "F28004x_100PZ" --package "F28004x_100PZ" --context "system" --product "C2000WARE@26.01.00.00"
 * @versions {"tool":"1.28.0+4696"}
 */

/**
 * Import the modules used in this configuration.
 */
const cputimer  = scripting.addModule("/driverlib/cputimer.js", {}, false);
const cputimer1 = cputimer.addInstance();

/**
 * Write custom configuration values to the imported modules.
 */
cputimer1.$name              = "TIM0";
cputimer1.enableInterrupt    = true;
cputimer1.timerPeriod        = 19999;
cputimer1.registerInterrupts = true;
cputimer1.timerPrescaler     = 19999;
